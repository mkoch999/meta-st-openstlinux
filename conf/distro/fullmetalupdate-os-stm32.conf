## conf/distro/fullmetalupdate-os-stm32.conf
```bitbake
#@NAME: openstlinux-weston
#@DESCRIPTION: OpenSTLinux featuring Weston/Wayland (with GPLv3 software)

require include/st-default-distro-rules.inc
require include/st-default-distro-providers.inc
require include/openstlinux.inc
require conf/distro/sota.conf.inc
require conf/distro/variables.conf


DISTRO = "fullmetalupdate-os-stm32"
DISTRO_NAME = "FullMetalUpdate OS"
DISTRO_VERSION = "1.0"
DISTRO_CODENAME = ""
SDK_VENDOR = "-fullmetalupdate-sdk"
SDK_VERSION := "${@'${DISTRO_VERSION}'.replace('snapshot-${DATE}','snapshot')}"

MAINTAINER = "Witekio <tgagneret@witekio.com>"

TARGET_VENDOR = "-fullmetalupdate"

LOCALCONF_VERSION = "1"

DISTRO_VERSION[vardepsexclude] = "DATE"
SDK_VERSION[vardepsexclude] = "DATE"

# =========================================================================
# DISTRO features
# =========================================================================
DISTRO_FEATURES_append = " gplv3 "
DISTRO_FEATURES_append = " virtualization systemd sota"
DISTRO_FEATURES_append = " opengl"


PREFERRED_PROVIDER_virtual/runc = "runc-opencontainers"

INHERIT += " fullmetalupdate_sota"
```
